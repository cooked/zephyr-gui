
/* SPDX-License-Identifier: Apache-2.0 */

/ {
    chosen {
        zephyr-display = &ssd1306_0;
    };

};

&i2c1 {
	ssd1306_0:ssd1306@3c {
        compatible = "solomon,ssd1306fb";
        reg = <0x3c>;
        width = <64>;
        height = <128>;
        multiplex-ratio = <63>; // -1 than above
        segment-offset = <0>;
        page-offset = <0>;
        display-offset = <0>;
        prechargep = <0x22>;
        //segment-remap;
        //com-invdir;
    };
};
